## main/Kconfig.projbuild
```kconfig
menu "Duster controller"

    menu "Control"
        config CONTROL_PERIOD_MS
            int "Control task period (ms)"
            default 20
            help
                SPEC 5, design note 4.

        config DIAG_HANG_TASK
            string "Fault injection: hang this task 10 s after boot (empty = off)"
            default ""
            help
                Step 7 test. One of can_rx, control, aux, obd_client, ui. The
                task stops feeding the watchdog; expect a task watchdog reset
                within 3 s and a restart in MANUAL with lights off.

        config QUEUE_WAIT_MS
            int "Bounded queue wait before feeding the task watchdog (ms)"
            default 500
            help
                SPEC 5, Watchdog.

        config CAN_LIGHTS_TIMEOUT_MS
            int "Light-input CAN timeout, 0x5DE (ms)"
            default 750
            help
                In AUTO, forces MANUAL with both lights off. SPEC 6.2.

        config FROST_RISK_ON_C
            int "Frost risk on at or below (degC)"
            default 4

        config BELOW_FREEZING_ON_C
            int "Below freezing on at or below (degC)"
            default 0

        config TEMP_FLAG_HYSTERESIS_C
            int "Temperature flag hysteresis (degC)"
            default 2
            help
                A flag set at or below its threshold T clears only at or above
                T + hysteresis (default: frost risk on <= 4, off >= 6). Both
                flags are false while the temperature is stale.

        config STALE_DISPLAY_MS
            int "Speed / temperature stale timeout (ms)"
            default 1000
            help
                Value shown as unavailable; does not change mode. SPEC 6.2.
    endmenu

    menu "UI"
        config UI_LOOP_MS
            int "UI task loop period (ms)"
            range 5 10
            default 5
            help
                SPEC 5.

        config UI_BRINGUP_DIAG
            bool "Bring-up diagnostics"
            default n
            help
                Spike checks (SPEC 3.3): times full-screen redraws at boot
                (adds about 2 s) and logs touch input.

        config BUTTON_LONG_PRESS_MS
            int "Front button long press (ms)"
            default 1000
            help
                Short press = manual, all off. Long press = AUTO.

        config DISPLAY_BRIGHTNESS_DAY_DEFAULT_PCT
            int "Day brightness when no saved setting exists (%)"
            range 10 100
            default 80

        config DISPLAY_BRIGHTNESS_NIGHT_DEFAULT_PCT
            int "Night brightness when no saved setting exists (%)"
            range 10 100
            default 40
            help
                Night is selected while dipped beam is on (main beam holds the
                current state). Day and night levels are set separately with
                the encoder and saved.

        config DISPLAY_BRIGHTNESS_MIN_PCT
            int "Lowest brightness the encoder can set (%)"
            range 1 100
            default 10
            help
                Keeps the display from being turned fully off by accident.

        config DISPLAY_BRIGHTNESS_STEP_PCT
            int "Brightness change per encoder detent (%)"
            range 1 25
            default 5

        config SETTINGS_SAVE_DELAY_MS
            int "Save a changed setting after it is stable for (ms)"
            default 3000
            help
                Limits flash writes while the encoder is being turned.

        config SPEED_DISPLAY_HOLD_MS
            int "Speed display hold between updates (ms)"
            default 800
            help
                Per-variable display throttle in ui_bridge. SPEC 5, design note 5.
    endmenu

    menu "Aux light link (RA60)"
        config AUX_CH_LEDBAR
            int "LED bar library output_index (0-based)"
            range 0 5
            default 1
            help
                RA60 output 2. SPEC 7.2.

        config AUX_CH_FOG
            int "Aux fog library output_index (0-based)"
            range 0 5
            default 2
            help
                RA60 output 3. SPEC 7.2.

        config AUX_LOG_FRAMES
            bool "Log every RA60 frame sent and received (bring-up)"
            default n
            help
                Turns on the auxbeam-light-controller library's debug log:
                the hex of each command sent and of each 11-byte receive
                window it tries to decode. Also set Component config > Log >
                Maximum log verbosity to Debug, or nothing is printed.

        config AUX_POLL_MS
            int "aux task loop period (ms)"
            default 10

        config AUX_ACK_TIMEOUT_MS
            int "Per-command ACK timeout (ms)"
            default 400
            help
                RA60 turnaround measured on the bench: 150-220 ms from send
                to ACK received.

        config AUX_KEEPALIVE_MS
            int "Keepalive interval while idle, also back-off after failure (ms)"
            default 500

        config AUX_LINK_TIMEOUT_MS
            int "Aux link timeout without a valid ACK (ms)"
            default 1500
            help
                Normal ACK spacing is about 500-700 ms (keepalive plus
                turnaround); one late ACK and a retry can stretch it to
                about 1.3 s without the link being lost.

        config AUX_MISMATCH_MS
            int "Commanded vs ACKed mismatch before warning (ms)"
            default 1000
    endmenu

    menu "Wi-Fi / OTA"
        config WIFI_CONNECT_TIMEOUT_MS
            int "Wi-Fi connect timeout (ms)"
            default 20000
            help
                docs/ota-update-spec.md 3.1. On timeout, the connect attempt
                is abandoned and Wi-Fi is stopped.

        config DUSTER_WIFI_DEFAULT_SSID
            string "Build-time default Wi-Fi SSID (local builds only, empty = off)"
            default ""
            help
                docs/ota-update-spec.md 3.2. Used only if NVS has no stored
                credentials. Must be empty in the committed
                sdkconfig.defaults -- set only in a local, git-ignored
                sdkconfig for bench builds.

        config DUSTER_WIFI_DEFAULT_PSK
            string "Build-time default Wi-Fi PSK (local builds only, empty = off)"
            default ""
            help
                Paired with DUSTER_WIFI_DEFAULT_SSID above. Same rule:
                release binaries are public, so this must stay empty in
                sdkconfig.defaults.

        config OTA_MANIFEST_URL
            string "OTA manifest URL (empty = not configured)"
            default "https://mjholmes.github.io/duster-m5dial-controller/ota/manifest.json"
            help
                docs/ota-update-spec.md 6.2. Published by the release
                workflow (.github/workflows/release.yml) to the gh-pages
                branch. Override locally (not in the committed
                sdkconfig.defaults) to point at a bench-hosted test
                manifest instead, e.g. http://<laptop-lan-ip>:8000/manifest.json.

        config OTA_HTTP_BUFFER_SIZE
            int "esp_http_client RX buffer size for OTA (bytes)"
            default 2048
            help
                docs/ota-update-spec.md 10: GitHub's release-asset redirect
                uses a long signed URL: the default buffer can be too
                small to hold the response headers.

        config OTA_HTTP_BUFFER_SIZE_TX
            int "esp_http_client TX buffer size for OTA (bytes)"
            default 1024
    endmenu

    menu "CAN / OBD"
        config CAN_LISTEN_ONLY
            bool "TWAI listen-only mode (no ACKs, no OBD requests)"
            default n
            help
                Diagnostic option. Normal mode (the default) ACKs vehicle
                frames and sends the OBD requests for DTC reads; it was
                verified on the vehicle bus on 2026-09-29 (SPEC 8.5).
                Listen-only never transmits and disables DTC reads.

        config CAN_LOG_STATS
            bool "Log CAN statistics every 5 s (bring-up)"
            default y
            help
                Per-signal frame counts, malformed and unknown-value counters,
                decoded values, and every distinct ID seen.

        config CAN_DUMP_ID
            hex "Log raw data of this CAN ID when it changes (0 = off)"
            default 0x0
            help
                Bring-up aid for checking an unconfirmed signal against the
                vehicle. Requires CAN_LOG_STATS.

        config CAN_BUS_OFF_BACKOFF_MS
            int "Bus-off recovery back-off (ms)"
            default 1000
            help
                SPEC 8.5 requires a back-off but gives no value; 1000 ms is a
                firmware default.

        config DTC_IGNITION_WAIT_MS
            int "Wait for ignition Pos2/Running before first DTC read (ms)"
            default 5000

        config DTC_RETRY_MS
            int "DTC read retry interval (ms)"
            default 2000

        config DTC_RETRY_COUNT
            int "DTC read attempts before DTC_READ_FAILED"
            default 5

        config DTC_REPOLL_S
            int "PID 01 periodic re-poll interval (s)"
            default 600
            help
                10 minutes (decided 2026-09-29). DTCs are also read at every
                boot (ignition on) and after every engine start.

        config OBD_P2_MS
            int "OBD response timeout, P2 (ms)"
            default 50

        config ISOTP_CF_TIMEOUT_MS
            int "ISO-TP consecutive frame gap timeout (ms)"
            default 150
    endmenu

    menu "Tyres / 4WD"
        config TPMS_STALE_MS
            int "TPMS pressures stale timeout, 0x673 (ms)"
            default 750
            help
                docs/ui-tyres-4wd-spec.md 4 (OQ-14 convention). Stale/no-value
                is normal, not a fault -- display only, never raises
                can_timeout. 0xFF values are expected for about 30 s after
                moving off.

        config WHEEL_SPEED_STALE_MS
            int "Wheel speed stale timeout, 0x29A/0x29C (ms)"
            default 750

        config ETC_STALE_MS
            int "4WD/ETC status stale timeout, 0x1AA (ms)"
            default 750

        config TYRE_CAUTION_PSI_FRONT
            int "Front tyre caution threshold (psi, below)"
            default 27
            help
                docs/ui-tyres-4wd-spec.md 5, OQ-23. Placeholder pending the
                car's placard pressures.

        config TYRE_CAUTION_PSI_REAR
            int "Rear tyre caution threshold (psi, below)"
            default 27

        config TYRE_ALERT_PSI_FRONT
            int "Front tyre alert threshold (psi, below)"
            default 23

        config TYRE_ALERT_PSI_REAR
            int "Rear tyre alert threshold (psi, below)"
            default 23

        config TYRE_OVER_CAUTION_PSI_FRONT
            int "Front tyre over-inflation caution threshold (psi, above)"
            default 33
            help
                Added after an on-car test showed a 36 psi tyre reading OK
                with no over-inflation check at all -- the spec text only
                ever defined a lower bound. Placeholder pending the car's
                placard pressures, same as the under-inflation thresholds
                above.

        config TYRE_OVER_CAUTION_PSI_REAR
            int "Rear tyre over-inflation caution threshold (psi, above)"
            default 33

        config TYRE_OVER_ALERT_PSI_FRONT
            int "Front tyre over-inflation alert threshold (psi, above)"
            default 35

        config TYRE_OVER_ALERT_PSI_REAR
            int "Rear tyre over-inflation alert threshold (psi, above)"
            default 35

        config SLIP_CAUTION_PCT
            int "Wheel slip caution threshold (%, absolute)"
            default 5
            help
                docs/ui-tyres-4wd-spec.md 5, OQ-25. Placeholder pending a
                drive on a loose surface.

        config SLIP_ALERT_PCT
            int "Wheel slip alert threshold (%, absolute)"
            default 10

        config SLIP_HYSTERESIS_PCT
            int "Wheel slip severity hysteresis (%, falling only)"
            default 2

        config SLIP_SPEED_GATE_CENTI_KMH
            int "Minimum speed to compute wheel slip (0.01 km/h)"
            default 300
            help
                300 = 3 km/h. Below this, all four show NODATA / "--".

        config TYRE_WARN_SET_MS
            int "Speedo tyre-warning icon: raise after condition holds (ms)"
            default 2000
            help
                docs/ui-tyres-4wd-spec.md 9, OQ-30. Debounces the 30 mbar
                TPMS step size near a threshold.

        config TYRE_WARN_CLEAR_MS
            int "Speedo tyre-warning icon: clear after condition clear (ms)"
            default 10000
    endmenu

endmenu
```
